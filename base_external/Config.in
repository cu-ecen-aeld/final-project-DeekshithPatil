## base_external/Config.in
```kconfig
source "$BR2_EXTERNAL_project_base_PATH/package/gpio/Config.in"
source "$BR2_EXTERNAL_project_base_PATH/package/socket/Config.in"
source "$BR2_EXTERNAL_project_base_PATH/package/extra/Config.in"
source "$BR2_EXTERNAL_project_base_PATH/package/test/Config.in"
```

## base_external/package/extra/Config.in
```kconfig
config BR2_PACKAGE_EXTRA
	bool "EXTRA"
	help
	  Includes the custom developed gpio device driver in the kernel image.
```

## base_external/package/gpio/Config.in
```kconfig
config BR2_PACKAGE_GPIO
	bool "gpio"
	help
	  Includes the custom developed gpio device driver in the kernel image.
```

## base_external/package/socket/Config.in
```kconfig
config BR2_PACKAGE_SOCKET
	bool "socket"
	help
	  Includes the socket server executable in the kernel image.
```

## base_external/package/test/Config.in
```kconfig
config BR2_PACKAGE_TEST
	bool "test"
	help
	  Includes the socket server executable in the kernel image.
```
